## boards/shields/nice_simple/Kconfig.shield
```kconfig
# Copyright (c) 2024 ZMK
# SPDX-License-Identifier: MIT

config SHIELD_NICE_SIMPLE
	def_bool $(shields_list_contains,nice_simple)

config SHIELD_SOFLE_LEFT
	def_bool $(shields_list_contains,sofle_left)

config SHIELD_SOFLE_RIGHT
	def_bool $(shields_list_contains,sofle_right)
	
```

## boards/shields/sofle/Kconfig.defconfig
```kconfig
if SHIELD_SOFLE_DONGLE || SHIELD_SOFLE_LEFT_CENTRAL

config ZMK_KEYBOARD_NAME
    default "Cygnus"

config ZMK_SPLIT_ROLE_CENTRAL
    default y

endif

if ZMK_DISPLAY

config I2C
    default y

config SSD1306
    default y

choice ZMK_DISPLAY_WORK_QUEUE
    default ZMK_DISPLAY_WORK_QUEUE_DEDICATED
endchoice

endif

if LVGL

config LV_Z_VDB_SIZE
    default 64

config LV_DPI_DEF
    default 148

config LV_Z_BITS_PER_PIXEL
    default 1

choice LV_COLOR_DEPTH
    default LV_COLOR_DEPTH_1
endchoice

endif

if SHIELD_SOFLE_DONGLE || SHIELD_SOFLE_LEFT_CENTRAL || SHIELD_SOFLE_LEFT_PERIPHERAL || SHIELD_SOFLE_RIGHT

config ZMK_SPLIT
    default y

endif
```

## boards/shields/sofle/Kconfig.shield
```kconfig
# Copyright (c) 2024 ZMK
# SPDX-License-Identifier: MIT

config SHIELD_SOFLE_DONGLE
	def_bool $(shields_list_contains,sofle_dongle)

config SHIELD_SOFLE_LEFT_CENTRAL
	def_bool $(shields_list_contains,sofle_left_central)
config SHIELD_SOFLE_LEFT_PERIPHERAL
	def_bool $(shields_list_contains,sofle_left_peripheral)

config SHIELD_SOFLE_RIGHT
	def_bool $(shields_list_contains,sofle_right)
	
```

## boards/shields/tokeys/Kconfig.shield
```kconfig
# Copyright (c) 2024 ZMK
# SPDX-License-Identifier: MIT

config SHIELD_TOKEYS
	def_bool $(shields_list_contains,tokeys)

config SHIELD_TOKEYS_LEFT
	def_bool $(shields_list_contains,tokeys_left)

config SHIELD_TOKEYS_RIGHT
	def_bool $(shields_list_contains,tokeys_right)
	
```

## config/west.yml
```yaml
manifest:
  remotes:
    - name: zmkfirmware
      url-base: https://github.com/zmkfirmware
    # - name: englmaxi
    #   url-base: https://github.com/englmaxi
    # - name: bigtoe2
    #   url-base: https://github.com/bigtoe2
    # - name: ReFil
    #   url-base: https://github.com/ReFil
    # - name: tobiasarndt
    #   url-base: https://github.com/tobiasarndt
    # - name: infused-kim
    #   url-base: https://github.com/infused-kim
    # Additional modules containing boards/shields/custom code can be listed here as well
    # See https://docs.zephyrproject.org/3.2.0/develop/west/manifest.html#projects
  projects:
    - name: zmk
      remote: zmkfirmware
      revision: main
      import: app/west.yml

      # For left central
    # - name: zmk
    #   remote: ReFil
    #   revision: split-data-xfer
    #   import: app/west.yml

    # - name: zmk-dongle-display
    #   remote: englmaxi
    #   revision: main
    # - name: nice-view-gem
    #   remote: bigtoe2
    #   revision: main
    # - name: tmp-npv
    #   remote: bigtoe2
    #   # remote: infused-kim
    #   revision: main
  self:
    path: config
```
